## boards/viewe/esp32s3_smart_display/Kconfig
```kconfig
# Copyright (c) 2024 Jerónimo Agulló <jeronimoagullo97@gmail.com>
# SPDX-License-Identifier: Apache-2.0

config HEAP_MEM_POOL_ADD_SIZE_BOARD
	int
	default 4096 if BOARD_ESP32S3_SMART_DISPLAY_ESP32S3_PROCPU
	default 256 if BOARD_ESP32S3_SMART_DISPLAY_ESP32S3_APPCPU
```

## boards/viewe/esp32s3_smart_display/Kconfig.esp32s3_smart_display
```kconfig
# Copyright (c) 2024 Jerónimo Agulló <jeronimoagullo97@gmail.com>
# SPDX-License-Identifier: Apache-2.0

config BOARD_ESP32S3_SMART_DISPLAY
	select SOC_ESP32S3_WROOM_N8
	select SOC_ESP32S3_PROCPU if BOARD_ESP32S3_SMART_DISPLAY_ESP32S3_PROCPU
	select SOC_ESP32S3_APPCPU if BOARD_ESP32S3_SMART_DISPLAY_ESP32S3_APPCPU
```

## boards/viewe/esp32s3_smart_display/board.yml
```yaml
board:
  name: esp32s3_smart_display
  full_name: ESP32-S3-SMART-DISPLAY
  vendor: viewe
  socs:
  - name: esp32s3
```

## drivers/display/Kconfig.esp32_display
```kconfig
# Copyright (c) 2024 Espressif Systems (Shanghai) Co., Ltd.
# SPDX-License-Identifier: Apache-2.0

config DISPLAY_ESP32
	bool "Display interface driver"
	select DMA
	depends on DT_HAS_ESPRESSIF_ESP32_LCD_CAM_DISPLAY_ENABLED
	default y
	help
	  This option enables the display LCD interface for the esp32s3.
```

## dts/bindings/display/espressif,esp32-lcd.yaml
```yaml
# Copyright (c) Jerónimo Agulló Ocampos <jeronimoagullo97@gmail.com>
# SPDX-License-Identifier: Apache-2.0

description: ESP32s3 LCD-TFT display controller

compatible: "espressif,esp32-lcd-cam-display"

include: [lcd-controller.yaml, pinctrl-device.yaml, reset-device.yaml]

properties:
    bl-ctrl-gpios:
      type: phandle-array
      description: |
        Backlight on/off GPIO pin.
        Configure the GPIO polarity (active high/active low) according to LCD datasheet.
```

## dts/bindings/video/ovti,dvp.yaml
```yaml
#
# Copyright (c) 2019, Linaro Limited
#
# SPDX-License-Identifier: Apache-2.0
#

description: NXP MCUX CMOS sensor interface

compatible: "ovti,dvp"

include: [base.yaml, pinctrl-device.yaml]

properties:
  clk-gpio:
    required: true
    type: phandle-array
    description: |
      Identifies pin for the CKLK signal

  sensor:
    required: true
    type: phandle
    description: phandle of connected sensor device
```

## dts/bindings/video/ovti,ov7670.yaml
```yaml
# Copyright (c) 2021 Antmicro <www.antmicro.com>
# SPDX-License-Identifier: Apache-2.0

description: OV7670 CMOS video sensor

compatible: "ovti,ov7670"

properties:
  reset-gpios:
    type: phandle-array
    description: |
      The RESETn pin is asserted to disable the sensor causing a hard
      reset.  The sensor receives this as an active-low signal.
  dvp-gpios:
    required: true
    type: phandle-array
    description: |
      Identifies pins for control signals (hsync, vsync, href)
  data-gpios:
    required: false
    type: phandle-array
    description: |
      Identifies pins for pixel signals
  pwm:
    required: true
    type: phandle
    description: |
      Identifies pin for the CKLK signal

include: i2c-device.yaml
```
